## sdkconfig.defaults
```kconfig
#
# The-Defect — ESP-IDF sdkconfig defaults
# 目标芯片: ESP32-P4, LVGL v9, MIPI DSI 720×1280
# C6 协处理器: SDIO + ESP-Hosted + wifi_remote + NimBLE
#

# ============================================================
# 分区表 — 双 OTA (2MB×2) + FAT 数据分区 (16MB)
# ============================================================
CONFIG_PARTITION_TABLE_CUSTOM=y
CONFIG_PARTITION_TABLE_CUSTOM_FILENAME="partitions.csv"
CONFIG_PARTITION_TABLE_FILENAME="partitions.csv"
CONFIG_PARTITION_TABLE_MD5=y

# ============================================================
# 串行 Flash 配置 — 32MB QIO 80MHz
# ============================================================
CONFIG_ESPTOOLPY_FLASHMODE_QIO=y
CONFIG_ESPTOOLPY_FLASHMODE="dio"
CONFIG_ESPTOOLPY_FLASHFREQ_80M=y
CONFIG_ESPTOOLPY_FLASHFREQ="80m"
CONFIG_ESPTOOLPY_FLASHSIZE_32MB=y
CONFIG_ESPTOOLPY_FLASHSIZE="32MB"

# ============================================================
# PSRAM 配置 — Octal PSRAM 200MHz, 主堆在 PSRAM
# ============================================================
CONFIG_SPIRAM=y
CONFIG_SPIRAM_MODE_HEX=y
CONFIG_SPIRAM_SPEED_200M=y
CONFIG_SPIRAM_SPEED=200
CONFIG_SPIRAM_FETCH_INSTRUCTIONS=y
CONFIG_SPIRAM_RODATA=y
CONFIG_SPIRAM_XIP_FROM_PSRAM=y
CONFIG_SPIRAM_FLASH_LOAD_TO_PSRAM=y
CONFIG_SPIRAM_BOOT_HW_INIT=y
CONFIG_SPIRAM_BOOT_INIT=y
CONFIG_SPIRAM_PRE_CONFIGURE_MEMORY_PROTECTION=y
CONFIG_SPIRAM_USE_MALLOC=y
CONFIG_SPIRAM_MEMTEST=y
CONFIG_SPIRAM_MALLOC_ALWAYSINTERNAL=0
CONFIG_SPIRAM_MALLOC_RESERVE_INTERNAL=32768
CONFIG_SPIRAM_ALLOW_BSS_SEG_EXTERNAL_MEMORY=y

# ============================================================
# LDO 电压 — Flash 3.3V, PSRAM 1.8V
# ============================================================
CONFIG_ESP_LDO_RESERVE_SPI_NOR_FLASH=y
CONFIG_ESP_LDO_CHAN_SPI_NOR_FLASH_DOMAIN=1
CONFIG_ESP_LDO_VOLTAGE_SPI_NOR_FLASH_3300_MV=y
CONFIG_ESP_LDO_VOLTAGE_SPI_NOR_FLASH_DOMAIN=3300
CONFIG_ESP_LDO_RESERVE_PSRAM=y
CONFIG_ESP_LDO_CHAN_PSRAM_DOMAIN=2
CONFIG_ESP_LDO_VOLTAGE_PSRAM_1800_MV=y
CONFIG_ESP_LDO_VOLTAGE_PSRAM_DOMAIN=1800

# ============================================================
# CPU & 缓存 — 360MHz, L2 256KB, Cache Line 128B
# ============================================================
CONFIG_ESP_DEFAULT_CPU_FREQ_MHZ_360=y
CONFIG_ESP_DEFAULT_CPU_FREQ_MHZ=360
CONFIG_CACHE_L2_CACHE_256KB=y
CONFIG_CACHE_L2_CACHE_LINE_128B=y
CONFIG_MMU_PAGE_SIZE_64KB=y

# ============================================================
# FreeRTOS — 1000Hz 节拍, PSRAM 任务创建
# ============================================================
CONFIG_FREERTOS_HZ=1000
CONFIG_FREERTOS_CHECK_STACKOVERFLOW_CANARY=y
CONFIG_FREERTOS_TASK_CREATE_ALLOW_EXT_MEM=y
CONFIG_FREERTOS_IN_IRAM=y
CONFIG_FREERTOS_TLSP_DELETION_CALLBACKS=y

# ============================================================
# 编译器 — Debug 阶段使用 -Og
# ============================================================
CONFIG_COMPILER_OPTIMIZATION_DEBUG=y
CONFIG_COMPILER_HIDE_PATHS_MACROS=y
CONFIG_COMPILER_STACK_CHECK_MODE_NORM=y
CONFIG_COMPILER_STACK_CHECK=y
CONFIG_COMPILER_DISABLE_DEFAULT_ERRORS=y

# ============================================================
# ESP System — 主栈 32K, 双控制台, 看门狗
# ============================================================
CONFIG_ESP_MAIN_TASK_STACK_SIZE=32768
CONFIG_ESP_MAIN_TASK_AFFINITY_NO_AFFINITY=y
CONFIG_ESP_CONSOLE_SECONDARY_USB_SERIAL_JTAG=y
CONFIG_ESP_SYSTEM_IN_IRAM=y
CONFIG_ESP_INT_WDT=y
CONFIG_ESP_INT_WDT_TIMEOUT_MS=300
CONFIG_ESP_TASK_WDT_EN=y
CONFIG_ESP_TASK_WDT_INIT=y
CONFIG_ESP_TASK_WDT_TIMEOUT_S=5
CONFIG_ESP_DEBUG_OCDAWARE=y
CONFIG_ESP_SYSTEM_HW_STACK_GUARD=y
CONFIG_ESP_SYSTEM_HW_PC_RECORD=y
CONFIG_ESP_ALLOW_BSS_SEG_EXTERNAL_MEMORY=y
CONFIG_ESP_SYSTEM_RTC_FAST_MEM_AS_HEAP_DEPCHECK=y
CONFIG_ESP_SYSTEM_ALLOW_RTC_FAST_MEM_AS_HEAP=y

# ============================================================
# Flash 驱动 & DMA — IRAM 安全
# ============================================================
CONFIG_SPI_FLASH_PLACE_FUNCTIONS_IN_IRAM=y
CONFIG_SPI_FLASH_HPM_AUTO=y
CONFIG_GDMA_CTRL_FUNC_IN_IRAM=y
CONFIG_GDMA_ISR_HANDLER_IN_IRAM=y
CONFIG_GDMA_OBJ_DRAM_SAFE=y
CONFIG_ESP_TIMER_IN_IRAM=y

# ============================================================
# ESP-Hosted: C6 协处理器 (SDIO)
# ============================================================
CONFIG_ESP_HOSTED_ENABLED=y
CONFIG_ESP_HOSTED_CP_TARGET_ESP32C6=y
CONFIG_ESP_HOSTED_IDF_SLAVE_TARGET="esp32c6"
CONFIG_ESP_HOSTED_P4_DEV_BOARD_NONE=y
CONFIG_ESP_HOSTED_SDIO_HOST_INTERFACE=y
CONFIG_ESP_HOSTED_SDIO_RESET_ACTIVE_HIGH=y
CONFIG_ESP_HOSTED_SDIO_OPTIMIZATION_RX_STREAMING_MODE=y
CONFIG_ESP_HOSTED_SDIO_SLOT_1=y
CONFIG_ESP_HOSTED_SDIO_4_BIT_BUS=y
CONFIG_ESP_HOSTED_SDIO_CLOCK_FREQ_KHZ=40000
CONFIG_ESP_HOSTED_SDIO_PIN_CMD=19
CONFIG_ESP_HOSTED_SDIO_PIN_CLK=18
CONFIG_ESP_HOSTED_SDIO_PIN_D0=14
CONFIG_ESP_HOSTED_SDIO_PIN_D1=15
CONFIG_ESP_HOSTED_SDIO_PIN_D2=16
CONFIG_ESP_HOSTED_SDIO_PIN_D3=17
CONFIG_ESP_HOSTED_SDIO_GPIO_RESET_SLAVE=54
CONFIG_ESP_HOSTED_GPIO_SLAVE_RESET_SLAVE=54
CONFIG_ESP_HOSTED_SLAVE_RESET_ON_EVERY_HOST_BOOTUP=y

# ESP-Hosted: NimBLE (C6 上运行)
CONFIG_ESP_HOSTED_ENABLE_BT_NIMBLE=y
CONFIG_ESP_HOSTED_NIMBLE_HCI_VHCI=y
CONFIG_ESP_HOSTED_DFLT_TASK_STACK=4096
CONFIG_ESP_HOSTED_DFLT_TASK_FROM_SPIRAM=y

# ESP-Hosted: 数据限流
CONFIG_ESP_HOSTED_CLI_ENABLED=y
CONFIG_ESP_HOSTED_HOST_TO_ESP_WIFI_DATA_THROTTLE=y
CONFIG_ESP_HOSTED_TO_WIFI_DATA_THROTTLE_HIGH_THRESHOLD=80
CONFIG_ESP_HOSTED_TO_WIFI_DATA_THROTTLE_LOW_THRESHOLD=60
CONFIG_ESP_HOSTED_ENABLE_PEER_DATA_TRANSFER=y
CONFIG_ESP_HOSTED_MAX_SIMULTANEOUS_SYNC_RPC_REQUESTS=5
CONFIG_ESP_HOSTED_MAX_SIMULTANEOUS_ASYNC_RPC_REQUESTS=5

# ============================================================
# NimBLE — 多连接手柄, HID Service, 大 MTU
# ============================================================
CONFIG_BT_ENABLED=y
CONFIG_BT_NIMBLE_ENABLED=y
CONFIG_BT_CONTROLLER_DISABLED=y
CONFIG_BT_NIMBLE_MEM_ALLOC_MODE_DEFAULT=y
CONFIG_BT_NIMBLE_PINNED_TO_CORE_0=y
CONFIG_BT_NIMBLE_HOST_TASK_STACK_SIZE=4096
CONFIG_BT_NIMBLE_MAX_CONNECTIONS=4
CONFIG_BT_NIMBLE_MAX_BONDS=3
CONFIG_BT_NIMBLE_MAX_CCCDS=8
CONFIG_BT_NIMBLE_ATT_PREFERRED_MTU=512
CONFIG_BT_NIMBLE_MSYS_1_BLOCK_COUNT=24
CONFIG_BT_NIMBLE_MSYS_1_BLOCK_SIZE=256
CONFIG_BT_NIMBLE_MSYS_2_BLOCK_COUNT=32
CONFIG_BT_NIMBLE_MSYS_2_BLOCK_SIZE=320
CONFIG_BT_NIMBLE_TRANSPORT_ACL_FROM_LL_COUNT=24
CONFIG_BT_NIMBLE_TRANSPORT_ACL_SIZE=255
CONFIG_BT_NIMBLE_TRANSPORT_EVT_COUNT=30
CONFIG_BT_NIMBLE_ATT_MAX_PREP_ENTRIES=64
CONFIG_BT_NIMBLE_GATT_MAX_PROCS=4
CONFIG_BT_NIMBLE_HID_SERVICE=y
CONFIG_BT_NIMBLE_50_FEATURE_SUPPORT=y
CONFIG_BT_NIMBLE_LL_CFG_FEAT_LE_2M_PHY=y
CONFIG_BT_NIMBLE_LL_CFG_FEAT_LE_CODED_PHY=y
CONFIG_BT_NIMBLE_EXT_SCAN=y
CONFIG_BT_NIMBLE_ENABLE_PERIODIC_SYNC=y
CONFIG_BT_NIMBLE_SECURITY_ENABLE=y
CONFIG_BT_NIMBLE_SM_LEGACY=y
CONFIG_BT_NIMBLE_SM_SC=y
CONFIG_BT_NIMBLE_ROLE_CENTRAL=y
CONFIG_BT_NIMBLE_ROLE_PERIPHERAL=y
CONFIG_BT_NIMBLE_ROLE_BROADCASTER=y
CONFIG_BT_NIMBLE_ROLE_OBSERVER=y
CONFIG_BT_NIMBLE_GATT_CLIENT=y
CONFIG_BT_NIMBLE_GATT_SERVER=y
CONFIG_BT_NIMBLE_LOG_LEVEL_INFO=y
CONFIG_BT_NIMBLE_SVC_HID_MAX_INSTANCES=2
CONFIG_BT_NIMBLE_SVC_HID_MAX_RPTS=3

# ============================================================
# WiFi Remote — C6 远程 WiFi (通过 ESP-Hosted SDIO)
# ============================================================
CONFIG_ESP_WIFI_REMOTE_ENABLED=y
CONFIG_ESP_WIFI_REMOTE_IDF_SPECIFIC_ADDED=y
CONFIG_SLAVE_IDF_TARGET_ESP32C6=y
CONFIG_ESP_WIFI_REMOTE_LIBRARY_HOSTED=y
CONFIG_ESP_WIFI_REMOTE_EAP_ENABLED=y
CONFIG_WIFI_RMT_STATIC_RX_BUFFER_NUM=16
CONFIG_WIFI_RMT_DYNAMIC_RX_BUFFER_NUM=32
CONFIG_WIFI_RMT_STATIC_TX_BUFFER=y
CONFIG_WIFI_RMT_STATIC_TX_BUFFER_NUM=16
CONFIG_WIFI_RMT_AMPDU_TX_ENABLED=y
CONFIG_WIFI_RMT_TX_BA_WIN=6
CONFIG_WIFI_RMT_AMPDU_RX_ENABLED=y
CONFIG_WIFI_RMT_RX_BA_WIN=16
CONFIG_WIFI_RMT_IRAM_OPT=y
CONFIG_WIFI_RMT_EXTRA_IRAM_OPT=y
CONFIG_WIFI_RMT_RX_IRAM_OPT=y
CONFIG_WIFI_RMT_ENABLE_WPA3_SAE=y
CONFIG_WIFI_RMT_SOFTAP_SUPPORT=y
CONFIG_WIFI_RMT_ENTERPRISE_SUPPORT=y

# ============================================================
# LWIP — NAT, DHCP 服务器, 多 sockets
# ============================================================
CONFIG_LWIP_LOCAL_HOSTNAME="espressif"
CONFIG_LWIP_TCPIP_TASK_PRIO=18
CONFIG_LWIP_MAX_SOCKETS=10
CONFIG_LWIP_SO_REUSE=y
CONFIG_LWIP_IP_FORWARD=y
CONFIG_LWIP_IPV4_NAPT=y
CONFIG_LWIP_IPV4_NAPT_PORTMAP=y
CONFIG_LWIP_DHCPS=y
CONFIG_LWIP_DHCPS_MAX_STATION_NUM=8
CONFIG_LWIP_DHCPS_STATIC_ENTRIES=y
CONFIG_LWIP_DHCPS_ADD_DNS=y
CONFIG_LWIP_IPV4=y
CONFIG_LWIP_IPV6=y
CONFIG_LWIP_MAX_ACTIVE_TCP=16
CONFIG_LWIP_MAX_LISTENING_TCP=16
CONFIG_LWIP_TCP_MSS=1440
CONFIG_LWIP_TCP_SND_BUF_DEFAULT=5760
CONFIG_LWIP_TCP_WND_DEFAULT=5760
CONFIG_LWIP_TCPIP_TASK_STACK_SIZE=3072

# ============================================================
# mDNS — 服务发现
# ============================================================
CONFIG_MDNS_MAX_INTERFACES=3
CONFIG_MDNS_MAX_SERVICES=10
CONFIG_MDNS_TASK_STACK_SIZE=4096
CONFIG_MDNS_PREDEF_NETIF_STA=y
CONFIG_MDNS_PREDEF_NETIF_AP=y
# ============================================================
# HTTP Server — WebSocket 支持
# ============================================================
CONFIG_HTTPD_MAX_REQ_HDR_LEN=1024
CONFIG_HTTPD_MAX_URI_LEN=512
CONFIG_HTTPD_WS_SUPPORT=y
CONFIG_HTTPD_SERVER_EVENT_POST_TIMEOUT=2000

# ============================================================
# LVGL 核心配置
# ============================================================
CONFIG_LV_CONF_SKIP=y
CONFIG_LV_COLOR_DEPTH_16=y
CONFIG_LV_DEF_REFR_PERIOD=16
CONFIG_LV_DPI_DEF=130
CONFIG_LV_OS_FREERTOS=y
CONFIG_LV_DRAW_THREAD_STACK_SIZE=32768
CONFIG_LV_DRAW_THREAD_PRIO=4
CONFIG_LV_DRAW_SW_DRAW_UNIT_CNT=2
CONFIG_LV_DRAW_SW_ASM_RISCV_V=y
CONFIG_LV_USE_DRAW_SW_ASM=3
CONFIG_LV_USE_FREETYPE=y
CONFIG_LV_FREETYPE_USE_LVGL_PORT=y
CONFIG_LV_FREETYPE_CACHE_FT_GLYPH_CNT=512
CONFIG_LV_USE_SNAPSHOT=y
CONFIG_LV_USE_OBSERVER=y
CONFIG_LV_FONT_MONTSERRAT_32=y
CONFIG_LV_FONT_DEFAULT_MONTSERRAT_32=y

# ============================================================
# LVGL Widgets — 全开
# ============================================================
CONFIG_LV_USE_ANIMIMG=y
CONFIG_LV_USE_ARC=y
CONFIG_LV_USE_BAR=y
CONFIG_LV_USE_BUTTON=y
CONFIG_LV_USE_BUTTONMATRIX=y
CONFIG_LV_USE_CHART=y
CONFIG_LV_USE_CHECKBOX=y
CONFIG_LV_USE_DROPDOWN=y
CONFIG_LV_USE_IMAGE=y
CONFIG_LV_USE_IMAGEBUTTON=y
CONFIG_LV_USE_KEYBOARD=y
CONFIG_LV_USE_LABEL=y
CONFIG_LV_USE_LED=y
CONFIG_LV_USE_LINE=y
CONFIG_LV_USE_LIST=y
CONFIG_LV_USE_MENU=y
CONFIG_LV_USE_MSG=y
CONFIG_LV_USE_ROLLER=y
CONFIG_LV_USE_SLIDER=y
CONFIG_LV_USE_SPAN=y
CONFIG_LV_USE_SPINBOX=y
CONFIG_LV_USE_SPINNER=y
CONFIG_LV_USE_SWITCH=y
CONFIG_LV_USE_TABLE=y
CONFIG_LV_USE_TABVIEW=y
CONFIG_LV_USE_TEXTAREA=y
CONFIG_LV_USE_TILEVIEW=y
CONFIG_LV_USE_WIN=y

# ============================================================
# ESP LVGL Adapter
# ============================================================
CONFIG_ESP_LVGL_ADAPTER_ENABLE_FS=y
CONFIG_ESP_LVGL_ADAPTER_ENABLE_DECODER=y
CONFIG_ESP_LVGL_ADAPTER_PARTIAL_AUX_IMG_CACHE=y
CONFIG_ESP_LVGL_ADAPTER_ENABLE_FREETYPE=y
CONFIG_ESP_LVGL_ADAPTER_ENABLE_FPS_STATS=y

# ============================================================
# FATFS — 4KB 扇区, 长文件名, PSRAM 缓存
# ============================================================
CONFIG_FATFS_VOLUME_COUNT=2
CONFIG_FATFS_LFN_HEAP=y
CONFIG_FATFS_SECTOR_4096=y
CONFIG_FATFS_CODEPAGE_DYNAMIC=y
CONFIG_FATFS_API_ENCODING_UTF_8=y
CONFIG_FATFS_ALLOC_PREFER_EXTRAM=y
CONFIG_WL_SECTOR_SIZE_4096=y

# ============================================================
# 音频编解码 — ES8311 + 全格式
# ============================================================
CONFIG_CODEC_ES8311_SUPPORT=y
CONFIG_AUDIO_DECODER_AAC=y
CONFIG_AUDIO_DECODER_MP3=y
CONFIG_AUDIO_DECODER_G711=y
CONFIG_AUDIO_DECODER_ADPCM=y
CONFIG_AUDIO_DECODER_AMR=y
CONFIG_AUDIO_DECODER_FLAC=y
CONFIG_AUDIO_DECODER_OPUS=y
CONFIG_AUDIO_DECODER_VORBIS=y
CONFIG_AUDIO_DECODER_ALAC=y
CONFIG_AUDIO_DECODER_PCM=y
CONFIG_AUDIO_DECODER_SBC=y
CONFIG_AUDIO_DECODER_LC3=y
CONFIG_AUDIO_DECODER_G722=y
CONFIG_AUDIO_ENCODER_AAC=y
CONFIG_AUDIO_ENCODER_MP3=y
CONFIG_AUDIO_ENCODER_G711=y
CONFIG_AUDIO_ENCODER_ADPCM=y
CONFIG_AUDIO_ENCODER_AMR=y
CONFIG_AUDIO_ENCODER_FLAC=y
CONFIG_AUDIO_ENCODER_OPUS=y
CONFIG_AUDIO_ENCODER_VORBIS=y
CONFIG_AUDIO_ENCODER_ALAC=y
CONFIG_AUDIO_ENCODER_PCM=y
CONFIG_AUDIO_ENCODER_SBC=y
CONFIG_AUDIO_ENCODER_LC3=y
CONFIG_AUDIO_ENCODER_G722=y
CONFIG_ESP_AUDIO_RENDER_MIXER_THREAD_STACK_SIZE=4096

# ============================================================
# 杂项
# ============================================================
CONFIG_MMAP_FILE_NAME_LENGTH=16
CONFIG_ESP_LCD_TOUCH_MAX_POINTS=5
CONFIG_LCD_DSI_ISR_HANDLER_IN_IRAM=y
CONFIG_PM_SLP_IRAM_OPT=y
CONFIG_ESP_NETIF_IP_LOST_TIMER_INTERVAL=120
```
