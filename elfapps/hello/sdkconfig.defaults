## elfapps/hello/sdkconfig.defaults
```kconfig
# 与主固件同芯片（ESP32-P4）
CONFIG_IDF_TARGET="esp32p4"
# project_so 宏依赖 DYNAMIC_LOAD_SHARED_OBJECT 才生效
CONFIG_ELF_LOADER=y
CONFIG_ELF_DYNAMIC_LOAD_SHARED_OBJECT=y
```
